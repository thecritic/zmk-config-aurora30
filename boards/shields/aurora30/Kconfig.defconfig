## boards/shields/aurora30/Kconfig.defconfig
```kconfig
if SHIELD_AURORA30_LEFT

config ZMK_BLE
	default y

config ZMK_USB
	default y

config ZMK_KEYBOARD_NAME
    default "Aurora30"

config ZMK_SPLIT_ROLE_CENTRAL
    default y

endif

if SHIELD_AURORA30_LEFT || SHIELD_AURORA40_RIGHT

config ZMK_SPLIT
    default y

endif
```

## boards/shields/aurora30/Kconfig.shield
```kconfig
# No whitespace after comma or in name!

config SHIELD_AURORA30_LEFT
    def_bool $(shields_list_contains,aurora30_left)

config SHIELD_AURORA30_RIGHT
    def_bool $(shields_list_contains,aurora30_right)
```
